ENTRY(_start)
OUTPUT_FORMAT(binary)
SECTIONS
{
    . = 0x7C00;

    .text.start : ALIGN(4K)
    {
        *(.text)
    }

    .rodata : ALIGN(4K)
    {
        *(.rodata)
    }

    .data : ALIGN(4K)
    {
        *(.data)
    }

    .bss : ALIGN(4K)
    {
        *(COMMON)
        *(.bss)
    }
}